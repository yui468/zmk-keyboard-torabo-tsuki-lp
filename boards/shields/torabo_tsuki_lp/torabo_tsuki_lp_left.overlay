#include "torabo_tsuki_lp.dtsi"
#include <input/processors.dtsi>
#include <dt-bindings/zmk/input_transform.h>

&pointing_listener {
    input-processors = <&zip_xy_transform (INPUT_TRANSFORM_X_INVERT | INPUT_TRANSFORM_Y_INVERT)>;

    layer_3_scroll {
        layers = <3>;
        input-processors = <
            &zip_xy_transform (INPUT_TRANSFORM_X_INVERT)
            &zip_xy_scaler 1 5
            &zip_xy_to_scroll_mapper
        >;
    };
};